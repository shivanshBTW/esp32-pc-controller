## main/Kconfig.projbuild
```kconfig
menu "WakeType"

    config PC_POWER_RELAY_GPIO
        int "POWER relay GPIO"
        default 4
        range 0 48

    config PC_RESET_RELAY_GPIO
        int "RESET relay GPIO"
        default 5
        range 0 48

    config PC_STATE_GPIO
        int "PC power-state sense GPIO (PC817)"
        default 6
        range 0 48

    config PC_RELAY_ACTIVE_LOW
        bool "Relay modules are active-low"
        default y
        help
            Most optocoupler relay boards: GPIO LOW = ON, GPIO HIGH = OFF.

    config PC_POWER_PRESS_MS
        int "Default power press duration (ms)"
        default 500
        range 50 2000

    config PC_RESET_PRESS_MS
        int "Default reset press duration (ms)"
        default 500
        range 50 2000

    config PC_DEFAULT_LONG_PRESS_MS
        int "Default long power hold (ms)"
        default 5000
        range 1000 8000

    config PC_MAX_RELAY_HOLD_MS
        int "Absolute maximum relay hold (ms)"
        default 8000
        range 1000 8000

endmenu
```

## sdkconfig.defaults
```kconfig
# Board: ESP32-S3-WROOM-1-N16R8 (16MB flash, 8MB Octal PSRAM)
CONFIG_IDF_TARGET="esp32s3"

CONFIG_ESPTOOLPY_FLASHSIZE_16MB=y
CONFIG_ESPTOOLPY_FLASHSIZE="16MB"

CONFIG_SPIRAM=y
CONFIG_SPIRAM_MODE_OCT=y
CONFIG_SPIRAM_SPEED_80M=y

CONFIG_ESP_CONSOLE_USB_SERIAL_JTAG=y
CONFIG_ESP_CONSOLE_UART_DEFAULT=n

CONFIG_FREERTOS_HZ=1000

CONFIG_ESP_WIFI_SOFTAP_SUPPORT=y

CONFIG_HTTPD_MAX_REQ_HDR_LEN=1024
CONFIG_HTTPD_MAX_URI_LEN=512

CONFIG_LOG_DEFAULT_LEVEL_INFO=y

# OTA dual-slot partition table
CONFIG_PARTITION_TABLE_CUSTOM=y
CONFIG_PARTITION_TABLE_CUSTOM_FILENAME="partitions.csv"
CONFIG_PARTITION_TABLE_FILENAME="partitions.csv"
CONFIG_PARTITION_TABLE_OFFSET=0x8000

# mDNS
CONFIG_MDNS_MAX_SERVICES=10

# Matter (ESP-Matter / CHIP) — keep SoftAP; do not copy example's CONFIG_ESP_WIFI_SOFTAP_SUPPORT=n
CONFIG_BT_ENABLED=y
CONFIG_BT_NIMBLE_ENABLED=y
CONFIG_BT_NIMBLE_ENABLE_CONN_REATTEMPT=n
CONFIG_LWIP_IPV6_AUTOCONFIG=y
CONFIG_LWIP_HOOK_IP6_ROUTE_DEFAULT=y
CONFIG_LWIP_HOOK_ND6_GET_GW_DEFAULT=y
CONFIG_LWIP_IPV6_NUM_ADDRESSES=6
CONFIG_MBEDTLS_HKDF_C=y
CONFIG_ENABLE_WIFI_AP=n
CONFIG_ENABLE_CHIP_SHELL=n
CONFIG_ENABLE_OTA_REQUESTOR=n
CONFIG_ESP_MATTER_MAX_DYNAMIC_ENDPOINT_COUNT=2
CONFIG_CHIP_DEVICE_VENDOR_NAME="WakeType"
CONFIG_CHIP_DEVICE_PRODUCT_NAME="WakeType PC"
CONFIG_CHIP_DEVICE_VENDOR_ID=0xFFF1
CONFIG_CHIP_DEVICE_PRODUCT_ID=0x8005
CONFIG_CHIP_FACTORY_NAMESPACE_PARTITION_LABEL="fctry"
```
